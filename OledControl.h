 
#include <GyverOLED.h>
const uint8_t bitmap_16x16[] PROGMEM = {
  0x7F, 0xBF, 0x43, 0x63, 0x37, 0x1B, 0x0D, 0x04, 0x04, 0x0D, 0x1B, 0x37, 0x6F, 0xDF, 0xBF, 0x7F,
  0xFF, 0xFF, 0x00, 0x00, 0x00, 0x00, 0xF8, 0xF8, 0xF8, 0xF8, 0x00, 0x00, 0x00, 0x00, 0xFF, 0xFF,
};
const uint8_t bitmap_16x20[] PROGMEM = {
  0xFF, 0xFF, 0x0F, 0x07, 0x03, 0xC1, 0xE1, 0xF1, 0xF1, 0xE1, 0xC1, 0x03, 0x07, 0x0F, 0xFF, 0xFF,
  0xFF, 0xFF, 0xF8, 0xE0, 0xC0, 0x01, 0x03, 0x03, 0x03, 0x03, 0x01, 0xC0, 0xE0, 0xF8, 0xFF, 0xFF,
  0x0F, 0x0F, 0x0F, 0x0F, 0x0F, 0x0F, 0x0E, 0x08, 0x08, 0x0E, 0x0F, 0x0F, 0x0F, 0x0F, 0x0F, 0x0F,
};

void loopOled() {
  oled.clear();
  oled.setScale(2);
  oled.setCursor(16, 3);
  oled.print(hour); oled.print(":");
  if (dt.minute < 10)
  {
    oled.print("0");
  }
  oled.print(minute); oled.print(":");
  if (dt.second < 10)
  {
    oled.print("0");
  }
  oled.print(second);
  oled.setScale(1);
  oled.setCursor(0, 0);
  if (dt.day < 10)
  {
    oled.print("0");
  }
  oled.print(dt.day); oled.print(".");
  if (dt.month < 10)
  {
    oled.print("0");
  }
  oled.print(dt.month); oled.print(".");
  oled.print(dt.year);
  oled.drawBitmap(0, 47, bitmap_16x16, 16, 16);
  oled.setCursor(18, 7);
  oled.print(clock.readTemperature());
  oled.drawBitmap(50, 47, bitmap_16x20, 16, 20);
  oled.setCursor(67, 7);
  oled.print("15");
  
  oled.update();
}
